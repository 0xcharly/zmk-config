/*
 * Copyright (c) 2026 Charly Delay
 *
 * SPDX-License-Identifier: MIT
 */

#include "skeletyl_studio.dtsi"

/ {
    chosen {
        zmk,kscan = &default_kscan;
    };

    default_kscan: kscan {
        compatible = "zmk,kscan-gpio-matrix";
        diode-direction = "row2col";
        row-gpios
            = <&pro_micro 18 GPIO_ACTIVE_HIGH> // Row0
            , <&pro_micro 5  GPIO_ACTIVE_HIGH> // Row1
            , <&pro_micro 4  GPIO_ACTIVE_HIGH> // Row2
            , <&pro_micro 9  GPIO_ACTIVE_HIGH> // Row3
            ;
    };
};
