/*
 * Copyright (c) 2026 Charly Delay
 *
 * SPDX-License-Identifier: MIT
 */

#include "cygnus_studio-peripherals.dtsi"

&default_kscan {
    col-gpios
        = <&pro_micro 9 GPIO_ACTIVE_HIGH> // Col0
        , <&pro_micro 8 GPIO_ACTIVE_HIGH> // Col1
        , <&pro_micro 7 GPIO_ACTIVE_HIGH> // Col2
        , <&pro_micro 6 GPIO_ACTIVE_HIGH> // Col3
        , <&pro_micro 5 GPIO_ACTIVE_HIGH> // Col4
        ;
};
