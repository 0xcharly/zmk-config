/*
 * Copyright (c) 2020 Pete Johanson
 * Copyright (c) 2024 burkfers
 * Copyright (c) 2024 Charly Delay <0@0xcharly.com>
 *
 * SPDX-License-Identifier: MIT
 */

/ {
	splinktegrated_r: connector_r {
		compatible = "bastardkb,splinktegrated-rows";
		#gpio-cells = <2>;
		gpio-map-mask = <0xffffffff 0xffffffc0>;
		gpio-map-pass-thru = <0 0x3f>;
		gpio-map
	 		= <1 0 &gpio0 26 0>	/* RP2040 gpio26 */
			, <2 0 &gpio0  5 0> /* RP2040 gpio5 */
			, <3 0 &gpio0  4 0> /* RP2040 gpio4 */
			, <4 0 &gpio0  9 0> /* RP2040 gpio9 */
			;
	};

	splinktegrated_c: connector_c {
		compatible = "bastardkb,splinktegrated-cols";
		#gpio-cells = <2>;
		gpio-map-mask = <0xffffffff 0xffffffc0>;
		gpio-map-pass-thru = <0 0x3f>;
		gpio-map
			= <1 0 &gpio0 28 0> /* RP2040 gpio28 */
      // NOTE: for splinky v2
			// , <2 0 &gpio0 15 0> /* RP2040 gpio15 */
			, <2 0 &gpio0 21 0> /* RP2040 gpio21 */
			, <3 0 &gpio0  6 0> /* RP2040 gpio6 */
			, <4 0 &gpio0  7 0> /* RP2040 gpio7 */
			, <5 0 &gpio0  8 0> /* RP2040 gpio8 */
			;
	};
};
