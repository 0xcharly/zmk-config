## config/boards/arm/rp2040_ce/Kconfig.board
```kconfig
# Copyright (c) 2022 Pete Johanson
# Copyright (c) 2024, Nicolas Munnich
# Copyright (c) 2024, Charly Delay
# SPDX-License-Identifier: Apache-2.0

config BOARD_RP2040_CE
	bool "RP2040 Community Edition"
	depends on SOC_RP2040
```

## config/boards/arm/rp2040_ce/Kconfig.defconfig
```kconfig
# Copyright (c) 2022, Peter Johanson
# Copyright (c) 2024, Nicolas Munnich
# Copyright (c) 2024, Charly Delay <0@0xcharly.com>
# SPDX-License-Identifier: Apache-2.0

if BOARD_RP2040_CE

config BOARD
	default "rp2040_ce"

config RP2_FLASH_W25Q080
	default y

if I2C_DW

config I2C_DW_CLOCK_SPEED
	default 125

endif #I2C_DW

config USB_SELF_POWERED
	default n

endif # BOARD_RP2040_CE
```

## config/boards/shields/cygnus/Kconfig.defconfig
```kconfig
# Copyright (c) 2026 Charly Delay
# SPDX-License-Identifier: MIT

if SHIELD_CYGNUS_LEFT

config ZMK_KEYBOARD_NAME
	default "Cygnus L"

endif

if SHIELD_CYGNUS_RIGHT

config ZMK_KEYBOARD_NAME
	default "Cygnus R"

endif

if SHIELD_CYGNUS_LEFT || SHIELD_CYGNUS_RIGHT

config ZMK_SPLIT
	default y

endif
```

## config/boards/shields/cygnus_dongle/Kconfig.shield
```kconfig
# https://zmk.dev/docs/development/hardware-integration/dongle?studio-ready=nostudio
config SHIELD_CYGNUS_DONGLE
    def_bool $(shields_list_contains,cygnus_dongle)
```

## config/boards/shields/cygnus_studio/Kconfig.defconfig
```kconfig
# Copyright (c) 2026 Charly Delay
# SPDX-License-Identifier: MIT

if SHIELD_CYGNUS_STUDIO

# Max 16 characters in keyboard name
config ZMK_KEYBOARD_NAME
    default "Cygnus"

config ZMK_SPLIT
    default y

config ZMK_SPLIT_ROLE_CENTRAL
    default y

# Number of peripherals the dongle has
# For a unibody, this is 1. If you have left and right halves, this is 2, etc.
config ZMK_SPLIT_BLE_CENTRAL_PERIPHERALS
    default 2

# Set this to ZMK_SPLIT_BLE_CENTRAL_PERIPHERALS + your desired number of BT profiles (default is 5)
config BT_MAX_CONN
    default 3

# Set this to the same number as BT_MAX_CONN
config BT_MAX_PAIRED
    default 3

endif

if SHIELD_CYGNUS_STUDIO_LEFT

config ZMK_KEYBOARD_NAME
    default "Cygnus L"

config ZMK_SPLIT
    default y

endif

if SHIELD_CYGNUS_STUDIO_RIGHT

config ZMK_KEYBOARD_NAME
    default "Cygnus R"

config ZMK_SPLIT
    default y

endif
```

## config/boards/shields/cygnus_studio/Kconfig.shield
```kconfig
# Copyright (c) 2026 Charly Delay
# SPDX-License-Identifier: MIT

config SHIELD_CYGNUS_STUDIO
    def_bool $(shields_list_contains,cygnus_studio)

config SHIELD_CYGNUS_STUDIO_LEFT
    def_bool $(shields_list_contains,cygnus_studio_left)

config SHIELD_CYGNUS_STUDIO_RIGHT
    def_bool $(shields_list_contains,cygnus_studio_right)
```

## config/boards/shields/dilemma/Kconfig.defconfig
```kconfig
# Copyright (c) 2022 ZMK Contributors
# SPDX-License-Identifier: MIT
 
 
if SHIELD_DILEMMA_LEFT

config ZMK_KEYBOARD_NAME
	default "Dilemma"

config ZMK_SPLIT_BLE_ROLE_CENTRAL
	default y

endif

if SHIELD_DILEMMA_RIGHT

config ZMK_KEYBOARD_NAME
	default "Dilemma Right"

endif

if SHIELD_DILEMMA_LEFT || SHIELD_DILEMMA_RIGHT

config ZMK_SPLIT
	default y
	
endif
```

## config/boards/shields/rp2040_ce_holder/Kconfig.defconfig
```kconfig
if SHIELD_RP2040_CE_HOLDER

config ZMK_KEYBOARD_NAME
    default "Bastard Keyboards RP2040 CE Holder"

endif
```

## config/boards/shields/rp2040_ce_holder/Kconfig.shield
```kconfig
config SHIELD_RP2040_CE_HOLDER
    def_bool $(shields_list_contains,rp2040_ce_holder)
```

## config/boards/shields/scylla/Kconfig.shield
```kconfig
# Copyright (c) 2020 ZMK Contributors
# SPDX-License-Identifier: MIT

config SHIELD_SCYLLA_LEFT
	def_bool $(shields_list_contains,scylla_left)

config SHIELD_SCYLLA_RIGHT
	def_bool $(shields_list_contains,scylla_right)
```

## config/boards/shields/scylla_dmmpcb/Kconfig.defconfig
```kconfig
# Copyright (c) 2020 Derek Schmell
# SPDX-License-Identifier: MIT
 
 
if SHIELD_SCYLLA_LEFT

config ZMK_KEYBOARD_NAME
	default "Scylla"

config ZMK_SPLIT_BLE_ROLE_CENTRAL
	default y

endif

if SHIELD_SCYLLA_RIGHT

config ZMK_KEYBOARD_NAME
	default "Scylla Right"

endif

if SHIELD_SCYLLA_LEFT || SHIELD_SCYLLA_RIGHT

config ZMK_SPLIT
	default y
	
endif
```

## config/boards/shields/scylla_dmmpcb/Kconfig.shield
```kconfig
# Copyright (c) 2020 ZMK Contributors
# SPDX-License-Identifier: MIT

config SHIELD_SCYLLA_LEFT
	def_bool $(shields_list_contains,scylla_dmmpcb_left)

config SHIELD_SCYLLA_RIGHT
	def_bool $(shields_list_contains,scylla_dmmpcb_right)
```

## config/boards/shields/skeletyl/Kconfig.shield
```kconfig
# Copyright (c) 2026 Charly Delay
# SPDX-License-Identifier: MIT

config SHIELD_SKELETYL
    def_bool $(shields_list_contains,skeletyl)

config SHIELD_SKELETYL_LEFT
    def_bool $(shields_list_contains,skeletyl_left)

config SHIELD_SKELETYL_RIGHT
    def_bool $(shields_list_contains,skeletyl_right)
```

## config/boards/shields/skeletyl_34/Kconfig.shield
```kconfig
# Copyright (c) 2020 ZMK Contributors
# SPDX-License-Identifier: MIT

config SHIELD_SKELETYL_34_LEFT
	def_bool $(shields_list_contains,skeletyl_34_left)

config SHIELD_SKELETYL_34_RIGHT
	def_bool $(shields_list_contains,skeletyl_34_right)
```

## config/boards/shields/skeletyl_34_wired/Kconfig.defconfig
```kconfig
if SHIELD_SKELETYL_34_WIRED_RIGHT

config ZMK_KEYBOARD_NAME
    default "BastardKB Skeletyl"

config ZMK_SPLIT_ROLE_CENTRAL
    default y

endif

if SHIELD_SKELETYL_34_WIRED_LEFT || SHIELD_SKELETYL_34_WIRED_RIGHT

config ZMK_SPLIT
    default y
config ZMK_SPLIT_SERIAL
    default y

endif
```

## config/boards/shields/skeletyl_34_wired/Kconfig.shield
```kconfig
config SHIELD_SKELETYL_34_WIRED_LEFT
    def_bool $(shields_list_contains,skeletyl_34_wired_left)

config SHIELD_SKELETYL_34_WIRED_RIGHT
    def_bool $(shields_list_contains,skeletyl_34_wired_right)
```

## config/boards/shields/skeletyl_dongle/Kconfig.shield
```kconfig
# https://zmk.dev/docs/development/hardware-integration/dongle?studio-ready=nostudio
config SHIELD_SKELETYL_DONGLE
    def_bool $(shields_list_contains,skeletyl_dongle)
```

## config/boards/shields/skeletyl_studio/Kconfig.defconfig
```kconfig
# Copyright (c) 2026 Charly Delay
# SPDX-License-Identifier: MIT

if SHIELD_SKELETYL_STUDIO

# Max 16 characters in keyboard name.
config ZMK_KEYBOARD_NAME
    default "Skeletyl"

config ZMK_SPLIT
    default y

config ZMK_SPLIT_ROLE_CENTRAL
    default y

# Number of peripherals the dongle has.
# For a unibody, this is 1. If you have left and right halves, this is 2, etc.
config ZMK_SPLIT_BLE_CENTRAL_PERIPHERALS
    default 2

# Set this to ZMK_SPLIT_BLE_CENTRAL_PERIPHERALS + your desired number of BT profiles (default is 5)
config BT_MAX_CONN
    default 5

# Set this to the same number as BT_MAX_CONN
config BT_MAX_PAIRED
    default 5

endif

if SHIELD_SKELETYL_STUDIO_LEFT

config ZMK_KEYBOARD_NAME
    default "Skeletyl L"

config ZMK_SPLIT
    default y

endif

if SHIELD_SKELETYL_STUDIO_RIGHT

config ZMK_KEYBOARD_NAME
    default "Skeletyl R"

config ZMK_SPLIT
    default y

endif
```

## config/boards/shields/skeletyl_studio/Kconfig.shield
```kconfig
# Copyright (c) 2026 Charly Delay
# SPDX-License-Identifier: MIT

config SHIELD_SKELETYL_STUDIO
    def_bool $(shields_list_contains,skeletyl_studio)

config SHIELD_SKELETYL_STUDIO_LEFT
    def_bool $(shields_list_contains,skeletyl_studio_left)

config SHIELD_SKELETYL_STUDIO_RIGHT
    def_bool $(shields_list_contains,skeletyl_studio_right)
```

## config/boards/shields/skeletyl_v2_elitec/Kconfig.shield
```kconfig
# Copyright (c) 2020 ZMK Contributors
# SPDX-License-Identifier: MIT

config SHIELD_SKELETYL_LEFT
	def_bool $(shields_list_contains,skeletyl_v2_elitec_left)

config SHIELD_SKELETYL_RIGHT
	def_bool $(shields_list_contains,skeletyl_v2_elitec_right)
```

## config/skeletyl_defconfig
```kconfig
# "Equivalent" of asym_eager debounce.
CONFIG_BT_CTLR_TX_PWR_PLUS_8=y
#CONFIG_ZMK_SLEEP=n
CONFIG_ZMK_KSCAN_DEBOUNCE_PRESS_MS=1
CONFIG_ZMK_KSCAN_DEBOUNCE_RELEASE_MS=5

CONFIG_BT_GATT_ENFORCE_SUBSCRIPTION=n
```

## config/west.yml
```yaml
manifest:
  remotes:
    - name: upstream
      url-base: https://github.com/zmkfirmware

  projects:
    - name: zmk
      remote: upstream
      revision: ac7f75b8591d39aaf3b66b9d26f26c9ed921a009
      import: app/west.yml

  self:
    path: config
```
